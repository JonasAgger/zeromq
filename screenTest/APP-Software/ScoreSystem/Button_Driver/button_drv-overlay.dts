// Definitions for plat_drv module
// Adapted from w1-gpio-pullup-overlay.dts
/dts-v1/;
/plugin/;

/ {
  compatible = "brcm,bcm2835", "brcm,bcm2836", "brcm,bcm2708", "brcm,bcm2709";

  fragment@0 {
    /* Add device to base */
    target-path = "/";
    __overlay__ {
      /* "source tree ref label":"instance name" */
      knap: knap@0 {
        /* Label to match in driver */
        compatible = "ase, knap";

        /* Configure gpio module */
        gpios = <&gpio 10 0>, <&gpio 9 0>, <&gpio 11 0>;

        status = "okay";
      };
    };
  };
};
